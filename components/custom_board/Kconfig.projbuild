## components/custom_board/Kconfig.projbuild
```kconfig
# this was moved to audio_board

menu "S/PDIF output (WM8804)"
    depends on AUDIO_BOARD_CUSTOM

    config SPDIF_WM8804
        bool "WM8804 S/PDIF transmitter on the DAC's I2S bus"
        default n
        help
            Drive a Cirrus/Wolfson WM8804(G) that listens on the same I2S
            lines as the DAC and sends the audio out of an optical (TOSLINK)
            or coaxial S/PDIF port, in addition to the selected DAC. It is
            configured over I2C; see "I2S clock master" for the two ways a
            board can wire its clocks. If the WM8804 does not answer, the
            ESP32 runs as I2S master and the DAC keeps working.

    choice WM8804_CLOCKING
        prompt "I2S clock master"
        depends on SPDIF_WM8804
        default WM8804_CLK_ESP32_MASTER
        help
            Which chip generates MCLK/BCLK/LRCLK on the I2S bus.

        config WM8804_CLK_ESP32_MASTER
            bool "ESP32 (MCLK pin wired to WM8804 MCLK)"
            help
                The ESP32 is I2S master and outputs MCLK on "Master i2s mclk",
                which must be the GPIO wired to WM8804 pin 16: the WM8804 is
                an audio-interface slave whose transmitter runs from that
                MCLK. Up to 96 kHz (the WM8804 MCLK input limit).

        config WM8804_CLK_WM8804_MASTER
            bool "WM8804 (own crystal + PLL, ESP32 is I2S slave)"
            depends on !DAC_ADAU1961
            help
                No ESP32 GPIO reaches WM8804 MCLK (pin 16). The WM8804 makes
                MCLK, BCLK (64 fs) and LRCLK from its crystal and drives them
                to the ESP32 (I2S slave) and the DAC; nothing else may drive
                those nets, and "Master i2s mclk" is ignored. The PLL is
                trimmed continuously so the sample clock stays locked to the
                ESP32 clock (counting LRCLK on "Master i2s lrck"), which keeps
                multi-room sync intact. 32-96 kHz; other rates fall back to
                the ESP32 as master with the optical output off.
    endchoice

    config WM8804_XTAL_HZ
        int "WM8804 crystal frequency (Hz)"
        depends on WM8804_CLK_WM8804_MASTER
        range 10000000 27000000
        default 27000000
        help
            Frequency of the crystal on WM8804 pins 10/11 (printed on it),
            typically 27000000, 24000000 or 12000000. The WM8804 accepts
            10-14.4 MHz or 16.28-27 MHz.

    config WM8804_I2C_SDA
        int "WM8804 I2C SDA GPIO"
        depends on SPDIF_WM8804
        default -1

    config WM8804_I2C_SCL
        int "WM8804 I2C SCL GPIO"
        depends on SPDIF_WM8804
        default -1

    config WM8804_I2C_ADDR
        hex "WM8804 I2C address (7-bit)"
        depends on SPDIF_WM8804
        range 0x3A 0x3B
        default 0x3B
        help
            0x3A when the CSB/GPO1 pin is low at reset, 0x3B when it is high.

    config WM8804_I2C_PORT
        int "I2C controller used for the WM8804"
        depends on SPDIF_WM8804
        range 0 1
        default 1
        help
            DAC drivers that use I2C take controller 0, so the WM8804 uses
            controller 1 by default.

    config WM8804_RESET_PIN
        int "WM8804 RESETB GPIO (-1 if not wired)"
        depends on SPDIF_WM8804
        default -1
        help
            Active-low reset input of the WM8804. Leave at -1 if it is tied
            to an RC network or pull-up on the board.

endmenu
```

## components/sendspin_player/Kconfig
```kconfig
menu "Sendspin player"

    config SENDSPIN_PLAYER_ENABLE
        bool "Sendspin player (Music Assistant)"
        # its buffers live in PSRAM; the WM8804 I2C driver's clock hook and
        # slave mode are not wired into the Sendspin output yet
        depends on SPIRAM && !SPDIF_WM8804
        default n
        help
            Play Sendspin streams (Music Assistant's synchronized audio
            protocol) next to snapcast. While a Sendspin stream plays it owns
            the audio output; snapcast plays again 2 s after it ends.
            Needs PSRAM and ESP-IDF 5.5.2 or later. Not available with the
            WM8804 I2C driver (SPDIF_WM8804) yet.

    config SENDSPIN_PLAYER_PORT
        int "Sendspin WebSocket port"
        depends on SENDSPIN_PLAYER_ENABLE
        range 1 65535
        default 8928
        help
            The server (Music Assistant) connects to this port. 8928 is the
            port the Sendspin spec recommends.

    config SENDSPIN_UNPAIRED_ACCESS
        bool "Let servers play without pairing"
        depends on SENDSPIN_PLAYER_ENABLE
        default y
        help
            With this on, any Sendspin server on the network may play on this
            device without pairing first; Music Assistant then adds it with
            no setup step (the same default ESPHome uses). Turn it off to
            accept only paired servers ("require pairing").

            The Status tab of the settings page can change this at run time
            (kept across restarts); this sets the starting value.

            A server pairs with the 8-digit code shown on the Status tab,
            while the pairing window is open: a short press of the device
            button or "Allow pairing" on the Status tab opens it for 5
            minutes. Pair Music Assistant first, then require pairing:
            Music Assistant does not reconnect by itself after an unpaired
            connection is refused.

endmenu
```

## components/status_led/Kconfig.projbuild
```kconfig
menu "Status LED"

    choice STATUS_LED_TYPE
        prompt "Status LED type"
        default STATUS_LED_NONE
        help
            Optional RGB LED that shows the client state:
              white   booting
              amber   (blinking) connecting to WiFi / Ethernet
              magenta (blinking) no WiFi credentials stored yet
              blue    network up, looking for / connecting to the snapserver
              green   connected to the snapserver, idle or muted (dim)
              green   playing (bright)
              red     (blinking) fatal error (audio board init failed)
              cyan    (blinking) rescue / setup access point

        config STATUS_LED_NONE
            bool "None"
        config STATUS_LED_WS2812
            bool "Addressable WS2812 / SK6812 (single data pin)"
        config STATUS_LED_RGB_GPIO
            bool "Discrete RGB LED on three GPIOs"
    endchoice

    config STATUS_LED_WS2812_GPIO
        int "WS2812 data GPIO"
        depends on STATUS_LED_WS2812
        range -1 48
        default -1
        help
            GPIO connected to DIN of the first addressable LED.

    config STATUS_LED_WS2812_COUNT
        int "Number of LEDs in the chain"
        depends on STATUS_LED_WS2812
        range 1 16
        default 1

    config STATUS_LED_R_GPIO
        int "Red GPIO"
        depends on STATUS_LED_RGB_GPIO
        range -1 48
        default -1
    config STATUS_LED_G_GPIO
        int "Green GPIO"
        depends on STATUS_LED_RGB_GPIO
        range -1 48
        default -1
    config STATUS_LED_B_GPIO
        int "Blue GPIO"
        depends on STATUS_LED_RGB_GPIO
        range -1 48
        default -1
    config STATUS_LED_ACTIVE_LOW
        bool "LED is active low (common anode)"
        depends on STATUS_LED_RGB_GPIO
        default n

    config STATUS_LED_BRIGHTNESS
        int "Brightness (WS2812 only, 1-255)"
        depends on STATUS_LED_WS2812
        range 1 255
        default 40

endmenu
```

## components/web_rescue/Kconfig.projbuild
```kconfig
menu "Rescue / setup access point"

    config RESCUE_MODE_ENABLE
        bool "Enable the rescue access point"
        default n
        help
            For boards without a serial port. Instead of starting
            snapclient, the firmware opens a WiFi access point
            ("snapclient-XXXX") with a web page at http://192.168.4.1
            that sets the WiFi credentials, uploads new firmware (.bin) and
            switches between installed firmware slots. It is entered when:
              - the rescue button is held while the board powers up,
              - the button is held for 5 seconds while running,
              - no IP address was obtained within the timeout below.
            After the idle time below without any web request, the board
            reboots and tries normal operation again.

    config RESCUE_BUTTON_GPIO
        int "Rescue button GPIO (-1 = none)"
        depends on RESCUE_MODE_ENABLE
        range -1 48
        default -1

    config RESCUE_BUTTON_ACTIVE_LOW
        bool "Button pulls the pin LOW when pressed"
        depends on RESCUE_MODE_ENABLE
        default y

    config RESCUE_NO_IP_TIMEOUT_S
        int "Enter rescue mode if no IP after (seconds, 0 = never)"
        depends on RESCUE_MODE_ENABLE
        default 180

    config RESCUE_IDLE_REBOOT_S
        int "Leave rescue mode after this many idle seconds (0 = never)"
        depends on RESCUE_MODE_ENABLE
        default 600

    config RESCUE_AP_PASSWORD
        string "Rescue access point password (8+ chars, empty = open)"
        depends on RESCUE_MODE_ENABLE
        default "snapclient"

endmenu
```
